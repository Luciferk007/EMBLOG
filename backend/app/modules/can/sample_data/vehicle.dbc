VERSION ""

NS_ :

BS_:

BU_: ECU1 ECU2 ECU3

BO_ 291 EngineData: 8 ECU1
 SG_ EngineSpeed : 0|16@1+ (0.125,0) [0|8000] "rpm"
 SG_ OilTemp : 16|8@1+ (1,-40) [-40|215] "degC"

BO_ 1110 VehicleData: 8 ECU2
 SG_ Speed : 0|16@1+ (0.01,0) [0|250] "km/h"

BO_ 2015 Diagnostics: 8 ECU3
 SG_ Mode : 0|8@1+ (1,0) [0|255] ""

VAL_ 2015 Mode 0 "Reserved" 1 "CurrentData" 2 "FreezeFrame" 3 "StoredDTC";
