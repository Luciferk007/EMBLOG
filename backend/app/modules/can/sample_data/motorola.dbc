VERSION ""

NS_ :

BS_:

BU_: ECU1

BO_ 256 MotorolaData: 8 ECU1
 SG_ Counter : 7|8@0+ (1,0) [0|255] ""
